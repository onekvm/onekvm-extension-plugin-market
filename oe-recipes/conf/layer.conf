## oe-recipes/conf/layer.conf
```bitbake
BBPATH .= ":${LAYERDIR}"

BBFILES += "${LAYERDIR}/recipes-*/*/*.bb \
            ${LAYERDIR}/recipes-*/*/*.bbappend"

BBFILE_COLLECTIONS += "onekvm-extension-plugin-market"
BBFILE_PATTERN_onekvm-extension-plugin-market := "^${LAYERDIR}/"
BBFILE_PRIORITY_onekvm-extension-plugin-market = "8"

LAYERDEPENDS_onekvm-extension-plugin-market = "core onekvm"
LAYERSERIES_COMPAT_onekvm-extension-plugin-market = "wrynose"
```
